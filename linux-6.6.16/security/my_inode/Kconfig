## linux-6.6.16/security/my_inode/Kconfig
```kconfig
config SECURITY_MY_INODE
    bool "MY INODE support"
    depends on SECURITY
    default n
    help
         this selects the My INODE LSM 
    
         If you are unsure how to answer this question,answer N.
```

## linux-6.6.16/security/my_test/Kconfig
```kconfig
config SECURITY_MYTEST
    bool "MY TEST support"
    depends on SECURITY
    default n
    help
   	 this selects the My Task LSM
   	 
   	 If you are unsure how to answer this question,answer N.
```

## linux-6.6.16/security/szranger/Kconfig
```kconfig
config SECURITY_SZRANGER
     bool "SZRANGER support"
     depends on SECURITY
     default n
     help
          this selects the SZRANGER LSM
 
          If you are unsure how to answer this question,answer N.
```
